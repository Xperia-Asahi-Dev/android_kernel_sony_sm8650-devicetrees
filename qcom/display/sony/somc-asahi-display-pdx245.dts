/dts-v1/;
/plugin/;

#include "../display/pineapple-sde-display-qrd.dtsi"
#include "pineapple-audio-qrd.dtsi"
#include "somc-asahi-display.dtsi"

/ {
	model = "Sony Corporation. PDX-245(Pineapple QRD)";
	compatible = "somc,pdx245-generic", "qcom,pineapple", "qcom,qrd";
	qcom,msm-id = <557 0x10000>, <557 0x20000>, <577 0x10000>, <577 0x20000>;
	qcom,board-id = <0x1000B 0>, <0xB 0>;
};
